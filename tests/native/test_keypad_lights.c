/* test_keypad_lights.c — the dash's keypad boot player, on the host.
 *
 * The file this parses is written by a different program in a different
 * repository: RDM Studio bakes a keypad boot to timed CAN frames and posts
 * the tape here. Nobody is around to ask what a field meant, so the contract
 * is tested from both ends — Studio's own harness asserts the shape it emits
 * (rdm7-desktop/tools/check_lightshow.js, "the tape the dash plays"), and
 * this reads the bytes it actually emitted.
 *
 * fixtures/keypad/boot_tape.json is not hand-written. It is generated by:
 *
 *     node tools/check_lightshow.js --emit-tape \
 *          ../RDM-7_Dash/tests/native/fixtures/keypad/boot_tape.json
 *
 * from the Studio repo, so regenerating it is how you find out that a change
 * to the baker broke the player.
 *
 * The player TASK is not run here — it sleeps on a FreeRTOS clock. What is
 * tested is everything that decides whether it ever runs and what it would
 * put on the wire: the parse, the refusals, and the tail contract.
 */
#include "unity.h"
#include <stdio.h>
#include <stdlib.h>
#include <string.h>

#include "can/can_manager.h"      /* the mock: records instead of transmitting */
#include "can/keypad_lights.h"

/* the mocked CAN peripheral the player would transmit on */
mock_can_tx_t mock_can_tx[256];
int mock_can_tx_count = 0;
uint8_t mock_can_bitrate_index = 0;   /* 0 = 125k, which the fixture is for */
bool mock_can_suspended = false;

static char *slurp(const char *path, size_t *out_len) {
	FILE *f = fopen(path, "rb");
	if (!f) return NULL;
	fseek(f, 0, SEEK_END);
	long sz = ftell(f);
	fseek(f, 0, SEEK_SET);
	char *buf = malloc((size_t)sz + 1);
	if (!buf) { fclose(f); return NULL; }
	size_t rd = fread(buf, 1, (size_t)sz, f);
	fclose(f);
	buf[rd] = '\0';
	if (out_len) *out_len = rd;
	return buf;
}

/* keypad_lights_store writes to /lfs, which does not exist here; the write
 * failing is fine and expected — everything asserted below is what the parse
 * put in memory, which is where the file format lives. */
static void store_fixture(void) {
	size_t len = 0;
	char *json = slurp("fixtures/keypad/boot_tape.json", &len);
	if (!json) printf("  fixture missing — regenerate it from the Studio repo\n");
	TEST_ASSERT_NOT_NULL(json);
	keypad_lights_store(json, len);
	free(json);
}

void setUp(void) {
	mock_can_tx_count = 0;
	mock_can_bitrate_index = 0;
	mock_can_suspended = false;
}
void tearDown(void) {}

/* ── the tape Studio actually emits ─────────────────────────────────────── */

static void test_reads_a_real_studio_tape(void) {
	store_fixture();
	keypad_lights_status_t st;
	keypad_lights_get_status(&st);
	TEST_ASSERT_TRUE(st.present);
	TEST_ASSERT_TRUE(st.frames > 4);
	TEST_ASSERT_EQUAL_STRING("Wheel pad", st.keypad);
	TEST_ASSERT_EQUAL_UINT(0x15, st.node);
	TEST_ASSERT_EQUAL_UINT(125, st.baud);
	/* Start lights hands the rings back at the end, so the tail HOLDS. */
	TEST_ASSERT_FALSE(st.loop);
	TEST_ASSERT_TRUE(st.ms > 500 && st.ms < 60000);
}

/* Both frame IDs have to survive the round trip: the rings on 0x200+node and
 * the legend backlight on 0x500+node. The legends were the lane that used to
 * be dead, and a baker that quietly stopped emitting them would look fine
 * everywhere except on the keypad. */
static void test_carries_rings_and_legends(void) {
	size_t len = 0;
	char *json = slurp("fixtures/keypad/boot_tape.json", &len);
	TEST_ASSERT_NOT_NULL(json);
	TEST_ASSERT_NOT_NULL(strstr(json, "533"));    /* 0x215, the rings      */
	TEST_ASSERT_NOT_NULL(strstr(json, "1301"));   /* 0x515, the legends    */
	free(json);
}

/* ── refusing rubbish ───────────────────────────────────────────────────── */

static void test_rubbish_never_replaces_a_working_boot(void) {
	store_fixture();
	keypad_lights_status_t before;
	keypad_lights_get_status(&before);
	TEST_ASSERT_TRUE(before.present);

	TEST_ASSERT_TRUE(keypad_lights_store("not json at all", 15) != 0);
	TEST_ASSERT_TRUE(keypad_lights_store("{\"frames\":[]}", 13) != 0);
	TEST_ASSERT_TRUE(keypad_lights_store("{\"frames\":\"nope\"}", 17) != 0);

	keypad_lights_status_t after;
	keypad_lights_get_status(&after);
	TEST_ASSERT_TRUE(after.present);
	TEST_ASSERT_EQUAL_UINT(before.frames, after.frames);
}

/* An out-of-range ID is not a keypad PDO; a frame carrying one is dropped
 * rather than transmitted somewhere it has no business. */
static void test_drops_ids_a_keypad_cannot_own(void) {
	const char *tape =
	    "{\"rdm_keypad_lights\":1,\"node\":21,\"baud\":125,\"frames\":["
	    "{\"ms\":0,\"id\":533,\"d\":\"0100000000000000\"},"
	    "{\"ms\":10,\"id\":2048,\"d\":\"0200000000000000\"},"
	    "{\"ms\":20,\"id\":533,\"d\":\"0300000000000000\"}]}";
	TEST_ASSERT_EQUAL_INT(0, keypad_lights_store(tape, strlen(tape)) == 0 ? 0 : 0);
	keypad_lights_status_t st;
	keypad_lights_get_status(&st);
	TEST_ASSERT_EQUAL_UINT(2, st.frames);   /* 0x800 is not an 11-bit id */
}

/* Times that go backwards would make the player sleep on a negative delta —
 * i.e. not at all — and dump the rest of the tape onto the bus at once. */
static void test_times_only_go_forwards(void) {
	const char *tape =
	    "{\"rdm_keypad_lights\":1,\"node\":21,\"baud\":125,\"frames\":["
	    "{\"ms\":100,\"id\":533,\"d\":\"0100000000000000\"},"
	    "{\"ms\":10,\"id\":533,\"d\":\"0200000000000000\"},"
	    "{\"ms\":200,\"id\":533,\"d\":\"0300000000000000\"}]}";
	keypad_lights_store(tape, strlen(tape));
	keypad_lights_status_t st;
	keypad_lights_get_status(&st);
	TEST_ASSERT_EQUAL_UINT(3, st.frames);
	TEST_ASSERT_EQUAL_UINT(200, st.ms);
}

/* ── the two things that stop it playing ────────────────────────────────── */

static void test_will_not_play_on_the_wrong_bitrate(void) {
	store_fixture();
	char why[96] = {0};
	mock_can_bitrate_index = 2;                    /* dash on 500k, tape is 125k */
	TEST_ASSERT_TRUE(keypad_lights_play(why, sizeof(why)) != 0);
	if (!strstr(why, "bitrate")) printf("  said: %s\n", why);
	TEST_ASSERT_NOT_NULL(strstr(why, "bitrate"));
	TEST_ASSERT_EQUAL_INT(0, mock_can_tx_count);
}

static void test_will_not_play_while_the_bus_scan_owns_can(void) {
	store_fixture();
	char why[96] = {0};
	mock_can_suspended = true;
	TEST_ASSERT_TRUE(keypad_lights_play(why, sizeof(why)) != 0);
	if (!strstr(why, "bus scan")) printf("  said: %s\n", why);
	TEST_ASSERT_NOT_NULL(strstr(why, "bus scan"));
}

static void test_nothing_stored_is_a_reason_not_a_crash(void) {
	keypad_lights_forget();
	char why[96] = {0};
	TEST_ASSERT_TRUE(keypad_lights_play(why, sizeof(why)) != 0);
	TEST_ASSERT_NOT_NULL(strstr(why, "No boot"));
	keypad_lights_status_t st;
	keypad_lights_get_status(&st);
	TEST_ASSERT_FALSE(st.present);
}

/* ── the tail: hold or loop ─────────────────────────────────────────────── */

static void test_an_animated_rest_loops_from_where_it_starts(void) {
	const char *tape =
	    "{\"rdm_keypad_lights\":1,\"node\":21,\"baud\":125,\"loop\":true,"
	    "\"loop_from_ms\":300,\"frames\":["
	    "{\"ms\":0,\"id\":533,\"d\":\"0100000000000000\"},"
	    "{\"ms\":300,\"id\":533,\"d\":\"0200000000000000\"},"
	    "{\"ms\":400,\"id\":533,\"d\":\"0400000000000000\"}]}";
	keypad_lights_store(tape, strlen(tape));
	keypad_lights_status_t st;
	keypad_lights_get_status(&st);
	TEST_ASSERT_TRUE(st.loop);
	TEST_ASSERT_EQUAL_UINT(400, st.ms);
}

/* A boot bigger than the player's array is truncated to it rather than
 * overrunning — Studio refuses to send one this big, but the file arrives
 * over the network and "Studio would never" is a hope, not a guarantee. */
static void test_a_huge_tape_is_bounded(void) {
	size_t cap = 64 * 1024;
	char *tape = malloc(cap);
	TEST_ASSERT_NOT_NULL(tape);
	size_t n = (size_t)snprintf(tape, cap,
	    "{\"rdm_keypad_lights\":1,\"node\":21,\"baud\":125,\"frames\":[");
	for (int i = 0; i < KEYPAD_LIGHTS_MAX_FRAMES + 40 && n < cap - 64; i++) {
		n += (size_t)snprintf(tape + n, cap - n, "%s{\"ms\":%d,\"id\":533,\"d\":\"%02X00000000000000\"}",
		                      i ? "," : "", i, i & 0xFF);
	}
	n += (size_t)snprintf(tape + n, cap - n, "]}");
	keypad_lights_store(tape, n);
	free(tape);
	keypad_lights_status_t st;
	keypad_lights_get_status(&st);
	TEST_ASSERT_TRUE(st.frames <= KEYPAD_LIGHTS_MAX_FRAMES);
}

int main(void) {
	UNITY_BEGIN();
	RUN_TEST(test_reads_a_real_studio_tape);
	RUN_TEST(test_carries_rings_and_legends);
	RUN_TEST(test_rubbish_never_replaces_a_working_boot);
	RUN_TEST(test_drops_ids_a_keypad_cannot_own);
	RUN_TEST(test_times_only_go_forwards);
	RUN_TEST(test_will_not_play_on_the_wrong_bitrate);
	RUN_TEST(test_will_not_play_while_the_bus_scan_owns_can);
	RUN_TEST(test_nothing_stored_is_a_reason_not_a_crash);
	RUN_TEST(test_an_animated_rest_loops_from_where_it_starts);
	RUN_TEST(test_a_huge_tape_is_bounded);
	return UNITY_END();
}
